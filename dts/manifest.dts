/*
 * Copyright 2019 The Hafnium Authors.
 *
 * Use of this source code is governed by a BSD-style
 * license that can be found in the LICENSE file or at
 * https://opensource.org/licenses/BSD-3-Clause.
 */

/dts-v1/;

/ {
	hypervisor {
		ffa_tee_enabled;
		compatible = "hafnium,hafnium";
		vm1 {
			debug_name = "linux_test";
			kernel_filename = "vmlinuz";
			ramdisk_filename = "initrd.img";
			smc_whitelist = <
				0x04000000
				0x3200ffff
				0x80000001
				>;
		};
	};
};